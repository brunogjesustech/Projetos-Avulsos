// =====================================================
// SilenceFM — Rádio para a Gabi (vulgo amoreco)
// Projeto: Arduino Uno + OLED SSD1306 128x64 + Buzzer
// Autor: Bruno G.
// =====================================================

#include <Wire.h>             // Comunicação I2C (usada pelo OLED)
#include <Adafruit_GFX.h>     // Biblioteca gráfica base da Adafruit
#include <Adafruit_SSD1306.h> // Driver do display OLED SSD1306

// --- Dimensões do display ---
#define SCREEN_WIDTH  128
#define SCREEN_HEIGHT 64
#define BUZZER_PIN    8   // Pino digital onde o buzzer passivo está conectado

// --- Inicializa o display via I2C, sem pino de reset (-1) ---
Adafruit_SSD1306 display(SCREEN_WIDTH, SCREEN_HEIGHT, &Wire, -1);

// --- Pino analógico do potenciômetro (define a estação) ---
const int potPin = A0;

// --- Controle de qual estação está ativa e quando foi trocada ---
int estacaoAtual = -1;         // Estação em exibição (-1 = nenhuma inicializada)
unsigned long tempoTroca = 0;
bool melodiaTocada = false;  // Melodia da estação atual já tocou?  // Timestamp (ms) da última troca de estação

// --- Variáveis para alternância de imagens na mensagem final ---
bool mostrarSegundaImagem = false;
unsigned long ultimaTroca = 0;

// =====================================================
// BITMAP — Frieren  128x64  PROGMEM
// Imagem exibida na intro, logo após "amoreco"
// Gerada via image2cpp em formato horizontal 1bpp
// =====================================================

const unsigned char frieren__[] PROGMEM = {
  0x00, 0x00, 0x00, 0x00, 0x00, 0xff, 0xff, 0xff, 0xff, 0xff, 0xdf, 0xdf, 0xe0, 0x00, 0x00, 0x00,
  0x00, 0x00, 0x00, 0x00, 0x1f, 0xff, 0xe0, 0x7f, 0xbf, 0xff, 0xff, 0xf7, 0xf0, 0x00, 0x00, 0x00,
  0x00, 0x00, 0x00, 0x00, 0xff, 0xff, 0xff, 0xe3, 0xe7, 0xff, 0xff, 0x7d, 0xfc, 0x00, 0x00, 0x00,
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  0x00, 0x20, 0x00, 0x00, 0x00, 0x00, 0x00, 0x00, 0x00, 0x00, 0x00, 0x00, 0x00, 0x00, 0x00, 0x03
};

// Array de ponteiros para os bitmaps da Frieren (facilita iteração futura)
const int frieren__allArray_LEN = 1;
const unsigned char* frieren__allArray[1] = { frieren__ };

// =====================================================
// BITMAP — Maomao  128x64  PROGMEM
// Imagem principal exibida na mensagem especial (estação 5)
// =====================================================

const unsigned char maomaoMaomao[] PROGMEM = {
  0xff, 0xff, 0xff, 0xc0, 0xff, 0xff, 0xff, 0xff, 0xff, 0xff, 0xff, 0xff, 0xff, 0x1f, 0xff, 0xff,
  0xff, 0xff, 0xff, 0xc0, 0x0f, 0xff, 0xff, 0xff, 0xff, 0xff, 0xff, 0xff, 0xf0, 0x0f, 0xff, 0xff,
  0xff, 0xff, 0xff, 0xc0, 0x01, 0xff, 0xff, 0xff, 0xff, 0xff, 0xff, 0xfe, 0x00, 0x07, 0xff, 0xff,
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  0xfe, 0x00, 0x00, 0x00, 0x00, 0x00, 0x00, 0x00, 0x00, 0x00, 0x00, 0x00, 0x00, 0x00, 0x00, 0x0f
};

// Array de ponteiros para os bitmaps da Maomao
const int maomaoallArray_LEN = 1;
const unsigned char* maomaoallArray[1] = { maomaoMaomao };

// =====================================================
// BITMAP — Maomao variante 2  128x64  PROGMEM
// Segunda imagem da Maomao, alternada com a primeira
// na mensagem final após os slides de texto
// =====================================================

const unsigned char mamao2baixados[] PROGMEM = {
  0x00, 0x00, 0x00, 0x00, 0x00, 0x00, 0x00, 0x3f, 0xf8, 0x00, 0x00, 0x00, 0x00, 0x00, 0x00, 0x00,
  0x00, 0x00, 0x00, 0x00, 0x00, 0x00, 0x01, 0xff, 0xff, 0x00, 0x00, 0x00, 0x00, 0x00, 0x00, 0x00,
  0x00, 0x00, 0x00, 0x00, 0x00, 0x00, 0x07, 0xff, 0xff, 0xc0, 0x00, 0x00, 0x00, 0x00, 0x00, 0x00,
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  0x00, 0x00, 0x80, 0x00, 0x18, 0x00, 0x00, 0x00, 0x00, 0x00, 0x00, 0x00, 0x00, 0x00, 0x00, 0x7f
};

// Array de ponteiros para os bitmaps da segunda Maomao
const int epd_bitmap_allArray_LEN = 1;
const unsigned char* epd_bitmap_allArray[1] = { mamao2baixados };

// =====================================================
// UTILITÁRIO — Centraliza texto no display
// texto  : string a exibir
// y      : posição vertical em pixels
// tamanho: escala do texto (1 = normal ~6px/char, 2 = grande ~12px/char)
// Deve-se chamar display.setTextSize() antes desta função
// =====================================================

void textoCentralizado(const char* texto, int y, int tamanho = 1) {
  int largura = strlen(texto) * 6 * tamanho; // 6px base por caractere × escala
  int x = (128 - largura) / 2;               // Calcula x para centralizar
  display.setCursor(x, y);
  display.println(texto);
}

// =====================================================
// INTRO — Sequência de abertura ao ligar o Arduino
// Exibe: "Silence" → "FM" → "Gabi (amoreco)" → Frieren → barra de carregamento
// =====================================================

void introRadio() {
  // --- Tela 1: "Silence" em fonte grande ---
  display.clearDisplay();
  display.setTextSize(2);
  display.setTextColor(WHITE);
  textoCentralizado("Silence", 15, 2); // Centralizado em textSize 2
  display.display();
  delay(1200);

  // --- Tela 2: "FM" em fonte grande ---
  display.clearDisplay();
  display.setTextSize(2);
  textoCentralizado("FM", 20, 2); // Centralizado em textSize 2
  display.display();
  delay(1200);

  // --- Tela 3: Dedicatória ---
  display.clearDisplay();
  display.setTextSize(1);
  textoCentralizado("Gabi", 10);
  textoCentralizado("(vulgo amoreco)", 30);
  display.display();
  delay(1500);

  // --- Tela 4: Bitmap da Frieren (surpresa!) ---
  display.clearDisplay();
  display.drawBitmap(0, 0, frieren__, 128, 64, WHITE);
  display.display();
  delay(2500);

  // --- Tela 5: Barra de carregamento animada ---
  for (int i = 0; i <= 10; i++) {
    display.clearDisplay();
    display.setTextSize(1);
    textoCentralizado("Sintonizando...", 15); // Texto centralizado
    display.drawRect(10, 35, 108, 12, WHITE); // Contorno da barra
    display.fillRect(12, 37, i * 10, 8, WHITE); // Preenchimento progressivo
    display.display();
    delay(120);
  }
  delay(400);
}

// =====================================================
// ANIMAÇÃO — Estrelas (estação 88.1 FM)
// 20 estrelas com posições fixas que piscam em ciclos
// A estrela mais brilhante ganha uma cruz de 4 pixels
// =====================================================

// Posições X e Y fixas das 20 estrelas na tela
const uint8_t starX[20] = { 6, 18, 32, 50, 65, 80, 100, 115, 12, 44, 72, 96, 24, 58, 88, 110, 38, 70, 105, 20 };
const uint8_t starY[20] = { 4, 12, 6, 16, 5, 11, 3, 8, 28, 22, 26, 20, 45, 40, 36, 50, 54, 48, 44, 58 };

void animacaoEstrelas() {
  unsigned long t = millis() >> 8; // Divide por 256 para desacelerar o ciclo

  for (int i = 0; i < 20; i++) {
    uint8_t fase = (t + i * 5) & 0x07; // Fase 0-7, defasada por estrela

    // Estrela visível nas fases 0-3 (metade do ciclo)
    if (fase < 4) {
      display.drawPixel(starX[i], starY[i], WHITE);
    }

    // Na fase 0, desenha cruz brilhante ao redor da estrela
    if (fase == 0) {
      if (starX[i] > 0)   display.drawPixel(starX[i] - 1, starY[i], WHITE);
      if (starX[i] < 127) display.drawPixel(starX[i] + 1, starY[i], WHITE);
      if (starY[i] > 0)   display.drawPixel(starX[i], starY[i] - 1, WHITE);
      if (starY[i] < 63)  display.drawPixel(starX[i], starY[i] + 1, WHITE);
    }
  }
}

// =====================================================
// ANIMAÇÃO — Coração batendo (estação 92.5 FM)
// Forma do coração desenhada pixel a pixel linha por linha:
// para cada Y, calcula a largura do coração naquela altura
// usando a equação paramétrica x² + (y - √|x|)² = 1 adaptada
// para inteiros. Sem float, sem triângulo torto.
// Batimento duplo (lub-dub) em ciclo de 900ms.
// =====================================================

// Desenha o coração centralizado em (cx, cy) com escala r (raio base ~10)
void desenharCoracao(int cx, int cy, int r) {
  // Varre as linhas de cima pra baixo dentro do bounding box do coração
  // Altura total: de -r (topo) até +r*1.2 (ponta)
  int alturaTotal = r + r * 6 / 5; // r + 120% de r

  for (int dy = -r; dy <= alturaTotal - r; dy++) {
    // Largura do coração nessa linha usando aproximação inteira
    // Topo (dy < 0): dois lobos circulares — largura por Pitágoras
    // Base (dy >= 0): triângulo que afunila até a ponta
    int metade;
    if (dy < 0) {
      // Zona dos lobos: círculo de raio r centrado em (±r/2, 0)
      // largura = 2 * sqrt(r² - (dy)²) + r (para cobrir os dois lobos)
      long rq = (long)r * r;
      long dq = (long)dy * dy;
      if (dq > rq) continue;
      metade = r / 2 + (int)sqrt((double)(rq - dq));
    } else {
      // Zona da ponta: afunila linearmente de largura=r até 0
      metade = r - (dy * r) / alturaTotal;
      if (metade < 0) metade = 0;
    }
    if (metade > 0) {
      display.drawLine(cx - metade, cy + dy, cx + metade, cy + dy, WHITE);
    }
  }
}

void animacaoCoracao() {
  unsigned long t = millis();
  int fase = (t % 600); // Ciclo de 600ms

  // Calcula o raio de acordo com a fase do batimento
  int r = 8; // Raio padrão (em repouso)
  if (fase < 100)       r = 8 + (fase / 34);        // Expande de 8 → 10
  else if (fase < 300)  r = 10;                       // Mantém expandido
  else if (fase < 400)  r = 10 - ((fase - 300) / 50); // Recolhe de 10 → 8

  int cx = 64, cy = 28; // Centro do coração

  // Dois círculos superiores formam o topo do coração
  display.fillCircle(cx - 11, cy - 3, r, WHITE);
  display.fillCircle(cx + 11, cy - 3, r, WHITE);

  // Triângulo forma a ponta inferior do coração
  display.fillTriangle(
    cx - 20, cy + 3,
    cx + 20, cy + 3,
    cx, cy + 20 + (r - 8) * 2, // Ponta se alonga quando expande
    WHITE
  );

  // Onda circular que irradia durante o pico do batimento
  if (fase >= 50 && fase < 150) {
    int raioOnda = 20 + (fase - 50) / 5; // Onda cresce de 20 a 40px
    display.drawCircle(cx, cy, raioOnda, WHITE);
  }
}

// =====================================================
// ANIMAÇÃO — Carro na estrada (estação 96.7 FM)
// Carro percorre a tela da esquerda para a direita em loop
// Estrada com traços animados no sentido do movimento
// =====================================================

void animacaoCarro() {
  unsigned long t = millis();
  // Posição X: avança continuamente, volta ao início após 170px
  int cx = (int)((t / 60UL) % 170) - 55;

  // --- Carroceria e teto ---
  display.fillRect(cx, 30, 52, 14, WHITE);       // Carroceria principal
  display.fillRect(cx + 9, 20, 32, 12, WHITE);   // Teto

  // --- Janelas (recortes pretos no teto) ---
  display.fillRect(cx + 11, 22, 10, 8, BLACK);   // Janela traseira
  display.fillRect(cx + 25, 22, 10, 8, BLACK);   // Janela dianteira

  // --- Rodas (círculo branco externo + preto interno) ---
  display.fillCircle(cx + 11, 46, 7, WHITE);     // Roda traseira
  display.fillCircle(cx + 40, 46, 7, WHITE);     // Roda dianteira
  display.fillCircle(cx + 11, 46, 3, BLACK);     // Cubo da roda traseira
  display.fillCircle(cx + 40, 46, 3, BLACK);     // Cubo da roda dianteira

  // --- Farol dianteiro ---
  display.fillRect(cx + 49, 32, 3, 4, WHITE);

  // --- Estrada ---
  display.drawLine(0, 53, 127, 53, WHITE); // Linha contínua superior

  // --- Traços animados da faixa central ---
  int dashOff = (int)((t / 60UL) % 20); // Offset dos traços acompanha o carro
  for (int i = -20; i < 148; i += 20) {
    int x1 = i + dashOff;
    int x2 = x1 + 10;
    if (x2 > 0 && x1 < 128) // Só desenha se dentro da tela
      display.drawLine(max(x1, 0), 58, min(x2, 127), 58, WHITE);
  }
}

// =====================================================
// ANIMAÇÃO — Chuva com nuvem (estação 101.3 FM)
// Nuvem se move da esquerda para a direita
// 12 gotas de chuva com velocidades variadas
// Poça com ondas animadas na base da tela
// =====================================================

void animacaoChuva() {
  unsigned long t = millis();

  // --- Nuvem em movimento ---
  int cloudX = (int)((t / 70UL) % 170) - 22; // Posição horizontal da nuvem
  if (cloudX > -22 && cloudX < 140) {         // Só desenha se visível
    int cx = cloudX;
    // Três círculos formam a nuvem (verificação de borda para evitar glitch)
    if (cx > -8)      display.fillCircle(cx, 10, 8, WHITE);
    if (cx + 11 > -9) display.fillCircle(cx + 11, 7, 9, WHITE);
    if (cx + 22 > -8) display.fillCircle(cx + 22, 10, 8, WHITE);
    // Base retangular da nuvem
    int rx = max(cx - 7, 0);
    int rw = min(cx + 30, 127) - rx;
    if (rw > 0) display.fillRect(rx, 13, rw, 5, WHITE);
  }

  // --- 12 gotas de chuva com velocidades e offsets diferentes ---
  for (int i = 0; i < 12; i++) {
    int speed = 2 + (i % 3);  // Velocidade: 2, 3 ou 4 (varia por gota)
    int x = i * 11 + 2;       // Posição X fixa por gota
    // Posição Y: cai continuamente, reinicia ao atingir o fundo
    int y = (int)((t / (unsigned long)speed / 8UL + (unsigned long)i * 13) % 46) + 18;
    if (x < 128 && y + 5 < 64)
      display.drawLine(x, y, x - 1, y + 5, WHITE); // Gota diagonal
  }

  // --- Poça com ondas animadas no fundo ---
  int ondaFase = (t / 200) % 4; // Ciclo de 4 fases, 200ms cada
  display.drawLine(48, 62, 80, 62, WHITE);                         // Base da poça
  if (ondaFase >= 1) display.drawLine(44, 61, 84, 61, WHITE);     // Onda 1
  if (ondaFase >= 2) display.drawLine(40, 60, 88, 60, WHITE);     // Onda 2
}

// =====================================================
// ANIMAÇÃO — Casinha (estação 104.6 FM)
// Casa com telhado, porta, janelas que acendem/apagam,
// chaminé com fumaça animada, lua crescente e estrelas
// =====================================================

void animacaoCasinha() {
  unsigned long t = millis();

  // --- Parâmetros da casa ---
  int hx = 34, hy = 28; // Canto superior esquerdo da parede
  int hw = 60, hh = 32; // Largura e altura da parede

  // --- Parede e telhado ---
  display.drawRect(hx, hy, hw, hh, WHITE);                         // Parede
  display.drawLine(hx, hy, hx + hw / 2, hy - 18, WHITE);          // Lado esquerdo do telhado
  display.drawLine(hx + hw, hy, hx + hw / 2, hy - 18, WHITE);     // Lado direito do telhado
  display.drawLine(hx, hy, hx + hw, hy, WHITE);                    // Base do telhado

  // --- Porta (centralizada na base da parede) ---
  int px = hx + hw / 2 - 5;
  display.drawRect(px, hy + hh - 14, 10, 14, WHITE); // Porta
  display.drawPixel(px + 8, hy + hh - 7, WHITE);     // Maçaneta

  // --- Janela esquerda com divisórias ---
  display.drawRect(hx + 6, hy + 6, 12, 10, WHITE);
  display.drawLine(hx + 12, hy + 6, hx + 12, hy + 16, WHITE); // Divisória vertical
  display.drawLine(hx + 6, hy + 11, hx + 18, hy + 11, WHITE); // Divisória horizontal

  // --- Janela direita com divisórias ---
  display.drawRect(hx + hw - 18, hy + 6, 12, 10, WHITE);
  display.drawLine(hx + hw - 12, hy + 6, hx + hw - 12, hy + 16, WHITE);
  display.drawLine(hx + hw - 18, hy + 11, hx + hw - 6, hy + 11, WHITE);

  // --- Luz nas janelas (pisca alternadamente a cada 600ms) ---
  int luz = (t / 600) % 4; // 4 fases: ambas acesas, esquerda, direita, apagadas
  if (luz == 0 || luz == 1) { // Janela esquerda acesa
    for (int wy = hy + 7; wy < hy + 11; wy += 2)
      for (int wx = hx + 7; wx < hx + 11; wx += 2)
        display.drawPixel(wx, wy, WHITE); // Pontilhado simula luz
  }
  if (luz == 1 || luz == 2) { // Janela direita acesa
    for (int wy = hy + 7; wy < hy + 11; wy += 2)
      for (int wx = hx + hw - 17; wx < hx + hw - 7; wx += 2)
        display.drawPixel(wx, wy, WHITE);
  }

  // --- Chaminé e fumaça animada ---
  display.drawRect(hx + hw - 16, hy - 24, 8, 10, WHITE); // Chaminé
  int fumo = (t / 200) % 3; // 3 bolinhas de fumaça em ciclo
  int fy = hy - 26;
  display.drawCircle(hx + hw - 12, fy - fumo * 3,      2, WHITE); // Bolinha 1
  display.drawCircle(hx + hw - 10, fy - fumo * 3 - 6,  2, WHITE); // Bolinha 2
  display.drawCircle(hx + hw - 13, fy - fumo * 3 - 11, 2, WHITE); // Bolinha 3

  // --- Elementos do cenário ---
  display.drawLine(0, 60, 127, 60, WHITE); // Chão
  display.drawPixel(8, 6, WHITE);          // Estrela 1
  display.drawPixel(20, 12, WHITE);        // Estrela 2
  display.drawPixel(14, 18, WHITE);        // Estrela 3

  // --- Lua crescente (canto superior direito) ---
  display.drawCircle(110, 12, 8, WHITE);   // Círculo da lua
  display.fillCircle(114, 10, 7, BLACK);  // "Morde" a lua para criar o crescente
}

// =====================================================
// MENSAGEM FINAL — Estação 107.9 FM
// Exibe slides de texto a cada 3 segundos com borda
// animada, depois alterna entre as duas imagens da Maomao
// =====================================================

void mensagemFinal(unsigned long tempoAnim) {
  unsigned long t = millis();

  // --- Borda pontilhada animada nas bordas da tela ---
  int bOff = (t / 130) % 2; // Alterna offset a cada 130ms
  for (int i = 0; i < 128; i += 4) {
    if (((i / 4) + bOff) % 2 == 0) {
      display.drawPixel(i, 0, WHITE);  // Borda superior
      display.drawPixel(i, 63, WHITE); // Borda inferior
    }
  }
  for (int i = 0; i < 64; i += 4) {
    if (((i / 4) + bOff) % 2 == 0) {
      display.drawPixel(0, i, WHITE);   // Borda esquerda
      display.drawPixel(127, i, WHITE); // Borda direita
    }
  }

  display.setTextSize(1);

  // Calcula qual slide mostrar (troca a cada 3000ms)
  int tela = tempoAnim / 3000;

  switch (tela) {
    case 0: // Slide 1
      textoCentralizado("Voce me acalma.", 28);
      break;

    case 1: // Slide 2
      textoCentralizado("Obrigado por", 22);
      textoCentralizado("estar aqui.", 36);
      break;

    case 2: // Slide 3
      textoCentralizado("Feliz Dia dos", 22);
      textoCentralizado("Namorados!", 36);
      break;

    case 3: // Slide 4
      textoCentralizado("Espero que goste,", 22);
      textoCentralizado("amoreco!", 36);
      break;

    case 4: // Slide 5
      textoCentralizado("Eu te amo,", 22);
      textoCentralizado("Gabriela!", 36);
      break;

    case 5: // Slide 6 — créditos
      textoCentralizado("Made with care", 22);
      textoCentralizado("Bruno G.", 36);
      break;

    // Casos 6, 7, 8: exibe a primeira imagem da Maomao por ~9 segundos
    case 6:
    case 7:
    case 8:
      display.drawBitmap(0, 0, maomaoMaomao, 128, 64, WHITE);
      break;

    // Default: alterna entre as duas imagens da Maomao a cada 10 segundos
    default:
      if ((millis() / 10000UL) % 2 == 0) {
        display.drawBitmap(0, 0, maomaoMaomao, 128, 64, WHITE);    // Imagem 1
      } else {
        display.drawBitmap(0, 0, mamao2baixados, 128, 64, WHITE);  // Imagem 2
      }
      break;
  }
}

// --- Funções auxiliares para exibir as imagens da Maomao diretamente ---

// Exibe a segunda variante da Maomao sem delay
void mostrarMaomao2() {
  display.clearDisplay();
  display.drawBitmap(0, 0, mamao2baixados, 128, 64, WHITE);
  display.display();
}

// Exibe a primeira variante da Maomao e aguarda 4 segundos
void mostrarMaomao() {
  display.clearDisplay();
  display.drawBitmap(0, 0, maomaoMaomao, 128, 64, WHITE);
  display.display();
  delay(4000);
}

// =====================================================
// BEEP — Gera tom no buzzer passivo via digitalWrite
// Não usa tone()/Timer2, sem conflito com o display I2C
// pino      : pino digital do buzzer
// frequencia: Hz da nota
// duracao   : duração em milissegundos
// =====================================================
void beep(int pino, int frequencia, int duracao) {
  long periodo = 1000000L / frequencia / 2;
  long ciclos  = (long)frequencia * duracao / 1000;

  for (long i = 0; i < ciclos; i++) {
    digitalWrite(pino, HIGH);
    delayMicroseconds(periodo);
    digitalWrite(pino, LOW);
    delayMicroseconds(periodo);
  }
}

// =====================================================
// INTRO — Jingle de abertura da rádio 8bit
// =====================================================
void tocarJingleIntro() {
  beep(BUZZER_PIN, 523,  80); delay(20);
  beep(BUZZER_PIN, 659,  80); delay(20);
  beep(BUZZER_PIN, 784,  80); delay(20);
  beep(BUZZER_PIN, 1047, 180);
}

// =====================================================
// 88.1 FM — Zelda's Lullaby (longa)
// =====================================================
void somEstrelas() {
  beep(BUZZER_PIN, 523, 300); delay(50);
  beep(BUZZER_PIN, 659, 300); delay(50);
  beep(BUZZER_PIN, 784, 500); delay(100);

  beep(BUZZER_PIN, 523, 300); delay(50);
  beep(BUZZER_PIN, 659, 300); delay(50);
  beep(BUZZER_PIN, 784, 500); delay(100);

  beep(BUZZER_PIN, 880, 300); delay(50);
  beep(BUZZER_PIN, 784, 300); delay(50);
  beep(BUZZER_PIN, 659, 500); delay(80);

  beep(BUZZER_PIN, 698, 300); delay(50);
  beep(BUZZER_PIN, 784, 300); delay(50);
  beep(BUZZER_PIN, 880, 600); delay(80);

  beep(BUZZER_PIN, 784, 300); delay(50);
  beep(BUZZER_PIN, 659, 300); delay(50);
  beep(BUZZER_PIN, 523, 800);
}

// =====================================================
// 92.5 FM — Pokémon Center (longa)
// =====================================================
void somCoracao() {
  beep(BUZZER_PIN, 523,  250); delay(40);
  beep(BUZZER_PIN, 659,  250); delay(40);
  beep(BUZZER_PIN, 784,  250); delay(40);
  beep(BUZZER_PIN, 1047, 500); delay(80);

  beep(BUZZER_PIN, 784,  250); delay(40);
  beep(BUZZER_PIN, 659,  250); delay(40);
  beep(BUZZER_PIN, 523,  500); delay(80);

  beep(BUZZER_PIN, 659,  250); delay(40);
  beep(BUZZER_PIN, 784,  250); delay(40);
  beep(BUZZER_PIN, 880,  400); delay(60);

  beep(BUZZER_PIN, 784,  250); delay(40);
  beep(BUZZER_PIN, 659,  250); delay(40);
  beep(BUZZER_PIN, 523,  700); delay(100);

  beep(BUZZER_PIN, 659,  250); delay(40);
  beep(BUZZER_PIN, 784,  500);
}

// =====================================================
// 96.7 FM — Mario Bros (bem longa)
// =====================================================
void somCarro() {
  beep(BUZZER_PIN, 659, 150); delay(30);
  beep(BUZZER_PIN, 659, 150); delay(180);
  beep(BUZZER_PIN, 659, 150); delay(180);

  beep(BUZZER_PIN, 523, 150); delay(30);
  beep(BUZZER_PIN, 659, 150); delay(180);
  beep(BUZZER_PIN, 784, 300); delay(300);

  beep(BUZZER_PIN, 392, 300); delay(300);

  beep(BUZZER_PIN, 523, 150); delay(100);
  beep(BUZZER_PIN, 392, 150); delay(100);
  beep(BUZZER_PIN, 330, 150); delay(100);

  beep(BUZZER_PIN, 440, 300); delay(80);
  beep(BUZZER_PIN, 494, 300); delay(80);
  beep(BUZZER_PIN, 466, 200); delay(50);
  beep(BUZZER_PIN, 440, 300); delay(80);

  beep(BUZZER_PIN, 392, 200); delay(50);
  beep(BUZZER_PIN, 659, 200); delay(50);
  beep(BUZZER_PIN, 784, 500); delay(100);

  beep(BUZZER_PIN, 880, 500);
}

// =====================================================
// 101.3 FM — Song of Storms (longa)
// =====================================================
void somChuva() {
  beep(BUZZER_PIN, 587, 250); delay(40);
  beep(BUZZER_PIN, 698, 250); delay(40);
  beep(BUZZER_PIN, 784, 400); delay(60);

  beep(BUZZER_PIN, 587, 250); delay(40);
  beep(BUZZER_PIN, 698, 250); delay(40);
  beep(BUZZER_PIN, 784, 400); delay(60);

  beep(BUZZER_PIN, 880, 250); delay(40);
  beep(BUZZER_PIN, 784, 250); delay(40);
  beep(BUZZER_PIN, 698, 500); delay(80);

  beep(BUZZER_PIN, 587, 250); delay(40);
  beep(BUZZER_PIN, 698, 250); delay(40);
  beep(BUZZER_PIN, 784, 500); delay(80);

  beep(BUZZER_PIN, 698, 250); delay(40);
  beep(BUZZER_PIN, 587, 700);
}

// =====================================================
// 104.6 FM — Tetris (longa)
// =====================================================
void somCasinha() {
  beep(BUZZER_PIN, 659, 250); delay(40);
  beep(BUZZER_PIN, 494, 125); delay(20);
  beep(BUZZER_PIN, 523, 125); delay(20);
  beep(BUZZER_PIN, 587, 250); delay(40);

  beep(BUZZER_PIN, 523, 125); delay(20);
  beep(BUZZER_PIN, 494, 125); delay(20);
  beep(BUZZER_PIN, 440, 250); delay(40);

  beep(BUZZER_PIN, 440, 125); delay(20);
  beep(BUZZER_PIN, 523, 125); delay(20);
  beep(BUZZER_PIN, 659, 250); delay(40);

  beep(BUZZER_PIN, 587, 250); delay(40);
  beep(BUZZER_PIN, 523, 500); delay(80);

  beep(BUZZER_PIN, 494, 250); delay(40);
  beep(BUZZER_PIN, 523, 250); delay(40);
  beep(BUZZER_PIN, 587, 500); delay(80);

  beep(BUZZER_PIN, 659, 500);
}

// =====================================================
// 107.9 FM — Undertale: His Theme — para a Gabriela
// =====================================================
void somEspecial() {
  beep(BUZZER_PIN, 523, 300); delay(40);
  beep(BUZZER_PIN, 659, 300); delay(40);
  beep(BUZZER_PIN, 784, 500); delay(60);

  beep(BUZZER_PIN, 698, 300); delay(40);
  beep(BUZZER_PIN, 659, 300); delay(40);
  beep(BUZZER_PIN, 523, 500); delay(60);

  beep(BUZZER_PIN, 392, 300); delay(40);
  beep(BUZZER_PIN, 523, 300); delay(40);
  beep(BUZZER_PIN, 659, 500); delay(60);

  beep(BUZZER_PIN, 784, 300); delay(40);
  beep(BUZZER_PIN, 659, 300); delay(40);
  beep(BUZZER_PIN, 523, 700); delay(80);

  beep(BUZZER_PIN, 392, 300); delay(40);
  beep(BUZZER_PIN, 523, 300); delay(40);
  beep(BUZZER_PIN, 784, 900);
}

// =====================================================
// SETUP — Executado uma única vez ao ligar o Arduino
// =====================================================

void setup() {
  pinMode(8, OUTPUT);
  display.begin(SSD1306_SWITCHCAPVCC, 0x3C);
  tocarJingleIntro();
  introRadio();
  
}

// =====================================================
// LOOP — Executado continuamente após o setup
// Lê o potenciômetro, determina a estação e
// exibe fase de texto (5s) ou animação conforme o tempo
// =====================================================

void loop() {
  // --- Leitura do potenciômetro (0-1023) ---
  int valor = analogRead(potPin);
  int estacao;

  // --- Mapeamento do valor analógico para 6 estações ---
  if      (valor < 170) estacao = 0; // 88.1 FM — Estrelas
  else if (valor < 340) estacao = 1; // 92.5 FM — Coração
  else if (valor < 510) estacao = 2; // 96.7 FM — Carro
  else if (valor < 680) estacao = 3; // 101.3 FM — Chuva
  else if (valor < 850) estacao = 4; // 104.6 FM — Casinha
  else                  estacao = 5; // 107.9 FM — Mensagem Especial

  // --- Detecta troca de estação e reseta o timer ---
  if (estacao != estacaoAtual) {
    estacaoAtual = estacao;
    tempoTroca = millis();
    melodiaTocada = false;
  }

  display.clearDisplay();

  // Tempo decorrido desde a entrada na estação atual
  unsigned long tempoNaEstacao = millis() - tempoTroca;

  // ---- FASE 1: Texto (primeiros 5 segundos) ----
  if (tempoNaEstacao < 5000UL) {
    display.setTextSize(1);

    switch (estacaoAtual) {
      case 0: // 88.1 FM — Estrelas
        textoCentralizado("88.1 FM", 0);
        textoCentralizado("As primeiras", 20);
        textoCentralizado("estrelas aparecem", 33);
        textoCentralizado("antes da noite.", 46);
        break;

      case 1: // 92.5 FM — Coração
        textoCentralizado("92.5 FM", 0);
        textoCentralizado("Algumas pessoas", 20);
        textoCentralizado("acalmam o mundo", 33);
        textoCentralizado("sem perceber.", 46);
        break;

      case 2: // 96.7 FM — Carro
        textoCentralizado("96.7 FM", 0);
        textoCentralizado("Toda jornada", 20);
        textoCentralizado("merece um momento", 33);
        textoCentralizado("pra respirar.", 46);
        break;

      case 3: // 101.3 FM — Chuva
        textoCentralizado("101.3 FM", 0);
        textoCentralizado("Depois da chuva,", 20);
        textoCentralizado("ate o silencio", 33);
        textoCentralizado("parece bonito.", 46);
        break;

      case 4: // 104.6 FM — Casinha
        textoCentralizado("104.6 FM", 0);
        textoCentralizado("Alguns lugares", 18);
        textoCentralizado("parecem casa.", 30);
        textoCentralizado("Algumas pessoas", 42);
        textoCentralizado("tambem.", 54);
        break;

      case 5: // 107.9 FM — Mensagem Especial
        textoCentralizado("107.9 FM", 0);
        textoCentralizado("Mensagem Especial", 30);
        break;
    }

    // --- Barra de progresso na base da tela ---
    display.drawRect(0, 61, 128, 3, WHITE);                         // Contorno
    int prog = (int)(tempoNaEstacao * 126UL / 5000UL);              // Progresso 0-126px
    display.fillRect(1, 62, prog, 1, WHITE);                        // Preenchimento

    // Toca a melodia uma vez ao entrar na estação, após exibir o texto
    if (!melodiaTocada && tempoNaEstacao > 300) {
      melodiaTocada = true;
      display.display(); // Garante que o texto aparece antes de bloquear
      switch (estacaoAtual) {
        case 0: somEstrelas(); break;
        case 1: somCoracao();  break;
        case 2: somCarro();    break;
        case 3: somChuva();    break;
        case 4: somCasinha();  break;
        case 5: somEspecial(); break;
      }
    }

  // ---- FASE 2: Animação (após 5 segundos) ----
  } else {
    unsigned long tempoAnim = tempoNaEstacao - 5000UL; // Tempo dentro da animação

    switch (estacaoAtual) {
      case 0: animacaoEstrelas();        break;
      case 1: animacaoCoracao();         break;
      case 2: animacaoCarro();           break;
      case 3: animacaoChuva();           break;
      case 4: animacaoCasinha();         break;
      case 5: mensagemFinal(tempoAnim);  break;
    }
  }

  // Envia o buffer para o display e aguarda ~35ms (~28fps)
  display.display();
  delay(35);
}
